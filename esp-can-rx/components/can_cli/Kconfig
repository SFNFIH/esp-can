## esp-can-rx/main/Kconfig.projbuild
```kconfig
menu "ESP-CAN-RX Configuration"

    config EXAMPLE_ESPNOW_CHANNEL
        int "ESP-NOW Wi-Fi channel"
        range 1 13
        default 1
        help
            Must match esp-can-tx SoftAP / ESP-NOW channel.

    config EXAMPLE_ESPNOW_PEER_MAC
        string "Default TX peer MAC (optional)"
        default "00:00:00:00:00:00"
        help
            If set to a non-zero MAC, CLI can send without waiting to learn peer.
            You can also set it at runtime: peer AA:BB:CC:DD:EE:FF

endmenu
```

## esp-can-rx/sdkconfig.defaults
```kconfig
CONFIG_IDF_TARGET="esp32s3"
CONFIG_EXAMPLE_ESPNOW_CHANNEL=1
CONFIG_EXAMPLE_ESPNOW_PEER_MAC="00:00:00:00:00:00"
CONFIG_ESP_CONSOLE_UART_DEFAULT=y
```

## esp-can-tx/main/Kconfig.projbuild
```kconfig
menu "ESP-CAN-TX Configuration"

    config EXAMPLE_TWAI_TX_GPIO
        int "TWAI TX GPIO Num"
        range 0 SOC_GPIO_OUT_RANGE_MAX
        default 4
        help
            GPIO for TWAI TX to the transceiver.

    config EXAMPLE_TWAI_RX_GPIO
        int "TWAI RX GPIO Num"
        range 0 SOC_GPIO_IN_RANGE_MAX
        default 5
        help
            GPIO for TWAI RX from the transceiver.

    config EXAMPLE_TWAI_BITRATE
        int "TWAI bitrate (bps)"
        default 500000
        help
            Vehicle CAN is commonly 500000 or 250000.

    config EXAMPLE_TWAI_LISTEN_ONLY
        bool "Listen-only mode on vehicle CAN bus"
        default y
        help
            Recommended when tapping an existing car bus so this node does not ACK.

    config EXAMPLE_WIFI_AP_SSID
        string "SoftAP SSID"
        default "ESP-CAN-TX"
        help
            Wi-Fi hotspot name for phone/PC web monitor.

    config EXAMPLE_WIFI_AP_PASSWORD
        string "SoftAP password"
        default "espcan123"
        help
            At least 8 characters for WPA2. Leave shorter only if you accept open AP.

    config EXAMPLE_ESPNOW_CHANNEL
        int "Wi-Fi / ESP-NOW channel"
        range 1 13
        default 1
        help
            SoftAP and ESP-NOW share this channel. Must match esp-can-rx.

    config EXAMPLE_ESPNOW_PEER_MAC
        string "ESP-NOW peer MAC (esp-can-rx)"
        default "FF:FF:FF:FF:FF:FF"
        help
            Destination MAC of esp-can-rx, e.g. AA:BB:CC:DD:EE:FF.

    config EXAMPLE_CAN_QUEUE_LEN
        int "CAN RX / forward queue length"
        range 8 256
        default 64
        help
            Frames buffered between TWAI ISR and forwarder task.

    config EXAMPLE_LOG_EVERY_N_FRAMES
        int "Log every N forwarded frames (0 = every frame)"
        range 0 10000
        default 50
        help
            Reduce UART spam on a busy vehicle bus.

endmenu
```

## esp-can-tx/sdkconfig.defaults
```kconfig
CONFIG_IDF_TARGET="esp32s3"
CONFIG_EXAMPLE_TWAI_BITRATE=500000
CONFIG_EXAMPLE_TWAI_LISTEN_ONLY=y
CONFIG_EXAMPLE_ESPNOW_CHANNEL=1
CONFIG_EXAMPLE_ESPNOW_PEER_MAC="FF:FF:FF:FF:FF:FF"
CONFIG_EXAMPLE_CAN_QUEUE_LEN=64
CONFIG_EXAMPLE_LOG_EVERY_N_FRAMES=50
```
